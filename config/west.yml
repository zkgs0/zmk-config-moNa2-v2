## config/west.yml
```yaml
manifest:
  remotes:
    - name: zmkfirmware
      url-base: https://github.com/zmkfirmware
    - name: cormoran    # <-- DYA Studio (custom ZMK fork + modules)
      url-base: https://github.com/cormoran
    - name: sayu-hub
      url-base: https://github.com/sayu-hub
    - name: badjeff    # <-- PMW3610
      url-base: https://github.com/badjeff
    - name: sekigon-gonnoc    # <-- PAW3222
      url-base: https://github.com/sekigon-gonnoc
    - name: caksoylar  # <-- RGB LED
      url-base: https://github.com/caksoylar
    - name: zettaface  # <-- Input Processor Keybind
      url-base: https://github.com/zettaface
    - name: t-ogura    # <-- Prospector Scanner (status advertisement)
      url-base: https://github.com/t-ogura
  projects:
    # ── ZMK 本体は cormoran さんの DYA Studio 対応 fork に切替 ──
    - name: zmk
      remote: cormoran
      revision: v0.3-branch+dya
      import: app/west.yml
    # ── DYA Studio modules ──
    - name: zmk-module-ble-management
      remote: cormoran
      revision: 851661c  # pin: v0.4移行(b7eccc3)の直前。fork v0.3-branch+dya 互換
    # zmk-module-battery-history は使わないので無効化
    # - name: zmk-module-battery-history
    #   remote: cormoran
    #   revision: main
    - name: zmk-module-settings-rpc
      remote: cormoran
      revision: ad1c995  # pin: 現HEAD。fork互換（relay関数はfork側に存在）
    - name: zmk-module-runtime-input-processor
      remote: cormoran
      revision: dbf92f7  # pin: v4移行(e643dfe)の直前。1引数 zmk_keymap_layer_activate 互換
    - name: zmk-behavior-runtime-sensor-rotate
      remote: cormoran
      revision: 3bbd992  # pin: 現HEAD（v4移行なし、fork互換）
    # ── 既存モジュール ──
    - name: zmk-pmw3610-driver
      remote: badjeff
      revision: zmk-0.3
    - name: zmk-driver-paw3222
      remote: sekigon-gonnoc
      revision: main
    - name: zmk-rgbled-widget
      remote: caksoylar
      revision: v0.3
    - name: zmk-input-processor-keybind
      remote: zettaface
      revision: main
    - name: prospector-zmk-module
      remote: t-ogura
      revision: v2.2.1
      path: modules/prospector-zmk-module
  self:
    path: config
```
